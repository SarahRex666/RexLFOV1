#include <Wire.h>
#include <Adafruit_MCP4725.h>
Adafruit_MCP4725 dac;
#define DAC_RESOLUTION    (12)
int ledPin = 5;
const int potPin = 20;
int modeSelector = 0;
const int buttonPin = 0;
unsigned long previousMillis = 0;
unsigned long lfoInterval = 0;
unsigned long randomChangeInterval = 0;

const int squareWaveTable[1024] = {
0, 0, 0, 0, 0, 0, 0, 0, 0, 0, 0, 0, 0, 0, 0, 0, 
0, 0, 0, 0, 0, 0, 0, 0, 0, 0, 0, 0, 0, 0, 0, 0, 
0, 0, 0, 0, 0, 0, 0, 0, 0, 0, 0, 0, 0, 0, 0, 0, 
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4095, 4095, 4095, 4095, 4095, 4095, 4095, 4095

};


const int triangleWaveTable[512] = 
{
16,32,48,64,80,96,112,128,
144,160,176,192,208,224,240,256,
272,288,304,320,336,352,368,384,
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112,96,80,64,48,32,16,0,
};

const int sineWaveTable[512] =
{
2048,2073,2098,2123,2148,2173,2198,2223,
2248,2273,2298,2323,2348,2373,2398,2422,
2447,2472,2496,2521,2545,2569,2594,2618,
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1847,1872,1897,1922,1947,1972,1997,2022,
};

void setup(void) {
  dac.begin(0x62);
  pinMode(ledPin, OUTPUT);
  pinMode(buttonPin, INPUT_PULLUP);
}


void loop() {
  int potValue = analogRead(potPin);
  int lfoRate = map(potValue, 0, 1023, 10, 500); // Map pot value to adjust LFO rate (slower max rate)
  int buttonState = digitalRead(buttonPin);

  if (buttonState == LOW) {
    modeSelector = (modeSelector + 1) % 4;
    delay(200);
  }

  switch (modeSelector) {
    case 0:
      // Sine wave
      for (int i = 0; i < 512; i++) {
        dac.setVoltage(sineWaveTable[i], false);
        int mappedValue = map(sineWaveTable[i], 0, 4095, 0, 50);
        analogWrite(ledPin, mappedValue);
        delayMicroseconds(lfoRate);  // Use delayMicroseconds within the loop
      }
      break;

    case 1:
      // Triangle wave
        for (int i = 0; i < 512; i++) {
          dac.setVoltage(triangleWaveTable[i], false);
          int mappedValue = map(triangleWaveTable[i], 0, 4095, 0, 50);
          analogWrite(ledPin, mappedValue);
          delayMicroseconds(lfoRate);  // Use delayMicroseconds within the loop
        }
      break;

    case 2:
      // Square wave
        for (int i = 0; i < 512; i++) {
          if (i < 256) {
            dac.setVoltage(4095, false);
            analogWrite(ledPin, 50);
          } else {
            dac.setVoltage(0, false);
            analogWrite(ledPin, 0);
          }
          delayMicroseconds(lfoRate);  // Use delayMicroseconds within the loop
        }
      break;

    case 3:
      // Random voltage
      {
        int randomNumber = random(4095);
        dac.setVoltage(randomNumber, false);
        int mappedValue = map(randomNumber, 0, 4095, 0, 50);
        analogWrite(ledPin, mappedValue);
        delay(lfoRate);  // Use delay with millis within the loop
      }
      break;

    default:
      // Reset modeSelector to 0 if it goes beyond 3
      modeSelector = 0;
      break;
  }
}
